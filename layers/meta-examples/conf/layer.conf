## layers/meta-examples/conf/layer.conf
```bitbake
# We have a conf and classes directory, add to BBPATH
BBPATH .= ":${LAYERDIR}"

# We have recipes-* directories, add to BBFILES
BBFILES += "${LAYERDIR}/recipes-*/*/*.bb \
            ${LAYERDIR}/recipes-*/*/*.bbappend"

BBFILE_COLLECTIONS += "meta-examples"
BBFILE_PATTERN_meta-examples = "^${LAYERDIR}/"
BBFILE_PRIORITY_meta-examples = "6"

LAYERDEPENDS_meta-examples = "core"
LAYERSERIES_COMPAT_meta-examples = "dunfell"
```

## layers/meta-mqtt/conf/layer.conf
```bitbake
# We have a conf and classes directory, add to BBPATH
BBPATH .= ":${LAYERDIR}"

# We have recipes-* directories, add to BBFILES
BBFILES += "${LAYERDIR}/recipes-*/*/*.bb \
            ${LAYERDIR}/recipes-*/*/*.bbappend"

BBFILE_COLLECTIONS += "meta-mqtt"
BBFILE_PATTERN_meta-mqtt = "^${LAYERDIR}/"
BBFILE_PRIORITY_meta-mqtt = "6"

LAYERDEPENDS_meta-mqtt = "core"
LAYERSERIES_COMPAT_meta-mqtt = "dunfell"
```

## layers/meta-processing/conf/layer.conf
```bitbake
# We have a conf and classes directory, add to BBPATH
BBPATH .= ":${LAYERDIR}"

# We have recipes-* directories, add to BBFILES
BBFILES += "${LAYERDIR}/recipes-*/*/*.bb \
            ${LAYERDIR}/recipes-*/*/*.bbappend"

BBFILE_COLLECTIONS += "meta-processing"
BBFILE_PATTERN_meta-processing = "^${LAYERDIR}/"
BBFILE_PRIORITY_meta-processing = "6"

LAYERDEPENDS_meta-processing = "core"
LAYERSERIES_COMPAT_meta-processing = "dunfell"
```
